// File Name: shadow_regfile_assign.sv
// Engineer:  Carl Grace (crgrace@lbl.gov)
// Description:  initializes shadow regfile to defaults          
///////////////////////////////////////////////////////////////////

        for (int i = 0; i < 64; i++) shadow_regfile[PIXEL_TRIM + i] = 8'h10;
        shadow_regfile[GLOBAL_THRESH] = 8'hFF;
        shadow_regfile[CSA_CTRL] = 8'h04;
        for (int i = 0; i < 8; i++) shadow_regfile[CSA_ENABLE + i] = 8'h00;
        shadow_regfile[IBIAS_TDAC] = 8'h08;
        shadow_regfile[IBIAS_COMP] = 8'h08;
        shadow_regfile[IBIAS_BUFFER] = 8'h08;
        shadow_regfile[IBIAS_CSA] = 8'h08;
        shadow_regfile[IBIAS_VREF] = 8'h08;
        shadow_regfile[IBIAS_VCM] = 8'h08;
        shadow_regfile[IBIAS_TPULSE] = 8'h05;
        shadow_regfile[REFGEN] = 8'h50;
        shadow_regfile[DAC_VREF] = 8'hDE;
        shadow_regfile[ADC_IBIAS_DELAY] = 8'h08;
        for (int i = 0; i < 8; i++) shadow_regfile[BYPASS_SELECT + i] = 8'h00;
        for (int i = 0; i < 8; i++) shadow_regfile[CSA_MONITOR_SEL + i] = 8'h00;
        for (int i = 0; i < 8; i++) shadow_regfile[CSA_TEST_ENABLE + i] = 8'hFF;
        shadow_regfile[CSA_TEST_DAC] = 8'h00;
        shadow_regfile[IMONITOR0] = 8'h00;
        shadow_regfile[IMONITOR1] = 8'h00;
        shadow_regfile[VMONITOR0] = 8'h00;
        shadow_regfile[VMONITOR1] = 8'h00;
        shadow_regfile[VMONITOR2] = 8'h00;
        shadow_regfile[DMONITOR0] = 8'h00;
        shadow_regfile[DMONITOR1] = 8'h00;
        shadow_regfile[FIFO_HW_LSB] = 8'h00;
        shadow_regfile[FIFO_HW_MSB] = 8'h00;
        shadow_regfile[TOTAL_PACKETS_LSB] = 8'h00;
        shadow_regfile[TOTAL_PACKETS_MSB] = 8'h00;
        shadow_regfile[DROPPED_PACKETS] = 8'h00;
        for (int i = 0; i < 2; i++) shadow_regfile[ADC_HOLD_DELAY + i] = 8'h00;
        shadow_regfile[CHIP_ID] = 8'h01;
        shadow_regfile[DIGITAL] = 8'h90;
        shadow_regfile[ENABLE_PISO_UP] = 8'h00;
        shadow_regfile[ENABLE_PISO_DOWN] = 8'h00;
        shadow_regfile[ENABLE_POSI] = 8'h0F;
        shadow_regfile[ANALOG_MONITOR] = 8'h00;
        shadow_regfile[ENABLE_TRIG_MODES] = 8'h60;
        shadow_regfile[SHADOW_RESET_LENGTH] = 8'h00;
        shadow_regfile[ADC_BURST] = 8'h00;
        for (int i = 0; i< 8; i++) shadow_regfile[CHANNEL_MASK + i] = 8'hFF;
        for (int i = 0; i < 8; i++) shadow_regfile[EXTERN_TRIG_MASK + i] = 8'hFF;
        for (int i = 0; i < 8; i++) shadow_regfile[CROSS_TRIG_MASK + i] = 8'hFF;
        for (int i = 0; i < 8; i++) shadow_regfile[PER_TRIG_MASK + i] = 8'hFF;
        for (int i = 0; i < 3; i++) 
            if (i == 1) shadow_regfile[RESET_CYCLES + i] = 8'h10;
            else shadow_regfile[RESET_CYCLES + i] = 8'h00;
        for (int i = 0; i < 4; i++) shadow_regfile[PER_TRIG_CYC + i] = 8'h0;
        shadow_regfile[ENABLE_ADC_MODES] = 8'h4C;
        shadow_regfile[MIN_DELTA_ADC] = 8'b00;
        shadow_regfile[RESET_THRESHOLD] = 8'hFF;
        for (int i = 0; i < 2; i++) shadow_regfile[DIGITAL_THRESHOLD_MSB + i] = 8'b00;
        for (int i = 0; i < 64; i++) shadow_regfile[DIGITAL_THRESHOLD_LSB + i]= 8'b00;
        shadow_regfile[TRX0] = 8'h88;
        shadow_regfile[TRX1] = 8'h88;
        shadow_regfile[TRX2] = 8'h88;
        shadow_regfile[TRX3] = 8'h88;
        shadow_regfile[TRX4] = 8'h00;
        shadow_regfile[TRX5] = 8'h00;
        shadow_regfile[TRX6] = 8'h00;
        shadow_regfile[TRX7] = 8'h00;
        shadow_regfile[TRX8] = 8'h02;
        shadow_regfile[TRX9] = 8'h02;
        shadow_regfile[TRX10] = 8'h02;
        shadow_regfile[TRX11] = 8'h02;
        shadow_regfile[TRX12] = 8'h00;
        shadow_regfile[TRX13] = 8'h00;
        shadow_regfile[TRX14] = 8'h00;
        shadow_regfile[TRX15] = 8'h55;
        shadow_regfile[TRX16] = 8'h55;
